## Kconfig
```kconfig
mainmenu "Chariot Kernel Configuration"

source "arch/Kconfig"


menu "Build"


	config CLANG
		bool "Use Clang"
		default n

	config DEBUG_SYMBOLS
		bool "Debug Symbols (-g)"
		default n

	config ADDITIONAL_KERNEL_FLAGS
		string "[kernel] Additional GCC Flags"
		default "-O2"

	config ADDITIONAL_USER_FLAGS
		string "[userspace] Additional GCC Flags"
		default "-O2"



	config DISK_SIZE_MB
		int "Size of the virtual hard drive in megabytes"
		default 256


	config OVERRIDE_TOOLCHAIN
		bool "Override toolchain prefix"
		depends on !CLANG
		default n

	config TOOLCHAIN_PREFIX
		string "Toolchain prefix"
		depends on OVERRIDE_TOOLCHAIN
		default "toolchain/..."


	config GCC_VERSION
		depends on !CLANG
		string "GCC Version"
		default "11.1.0"

endmenu

menu "Scheduler"

	config SMP
		bool "Symmetric multi-processing support"
		default y
		help
			Enable multiprocessing

	config PREFETCH_NEXT_THREAD
		bool "Prefetch next thread in tick irq"
		default y

	config TICKS_PER_SECOND
		int "Timer wakeup ticks per second"
		default 1000

endmenu



menu "Config"

	config QEMU_CORES
		int "Core count to use in QEMU"
		default "4"

	config MAX_CPUS
		int "Maximum Number of CPUs"
		range 1 64
		default "32"
		help 
			Specifies the maximum number of hardware CPUs supported by Chariot
			For uniprocessor environments, set this to 1

	config EXT2
		bool "Ext2 Filesystem"
		default y

	config PROCFS
		bool "Proc Filesystem"
		default y


	config LOW_MEMORY
		bool "Low memory mode (flush block cache when all refs are released, etc...)"
		default n


	menu "Runtime Debugging"
		config LOG_ERROR
			bool "Error Logging"
			default y

		config LOG_WARN
			bool "Warning Logging"
			default y

		config LOG_INFO
			bool "Info Logging"
			default y

		config LOG_DEBUG
			bool "Debug Information Logging"
			default y


		config VERBOSE_PROCESS
			bool "Verbose process debug"
			default n

	endmenu

endmenu


menu "Device Drivers"


	config UART_CONSOLE
		bool "Write console messages to the system UART"
		default y


	config ATA
		bool "ATA/IDE"
		default y
		depends on X86

	config ATA_DEBUG
		bool "ATA Debug Logging"
		default y
		depends on ATA


	config ATA_DMA
		bool "Enable ATA DMA access"
		default y
		depends on ATA

	
	config XHCI
		bool "XHCI USB Host Controller"
		default n
		depends on X86

	config AHCI
		bool "[WIP] Support for Advance Host Controller Interface drives"
		default n
		depends on X86

	config NVME
		bool "[WIP] Support for NVMe Drives"
		default n
		depends on X86

	config GENERIC_CHAR
		bool "Generic character devices (urandom, null, etc..) [RECOMMENDED]"
		default y

	config E1000
		bool "E1000 network cards"
		default y
		depends on X86
		depends on LWIP

	config RTL8139
		bool "RTL8139 network cards"
		default y
		depends on X86
		depends on LWIP

	config PS2_HID
		bool "PS2 HID devices (keyboard, mouse) [RECOMMENDED]"
		default y
		depends on X86

	menu "Video"
		config FRAMEBUFFER_WIDTH
			int "Width of the VGA framebuffer"
			default 1280

		config FRAMEBUFFER_HEIGHT
			int "Height of the VGA framebuffer"
			default 1024

		config FRAMEBUFFER_AUTODETECT
			bool "Autodetect framebuffer dimensions from BIOS/grub"
			default y

		config VGA
			bool "VGA displays beyond multiboot's boostrap [RECOMMENDED]"
			default y
			depends on X86

		config VMWARE_VIDEO
			bool "vmware displays"
			default n
			depends on X86
	endmenu

	config SB16
		bool "[WIP] Soundblaster 16"
		default y
		depends on X86


	config AC97
		bool "[WIP] AC97 Audio Driver"
		default y
		depends on X86


	config VIRTIO
		bool "Virtio Devices"
		default y


	config SIFIVE_UART
		bool "Sifive uart drivers"
		depends on RISCV
		default y

	config NS16550_UART
		bool "ns16550 uart drivers"
		default y
		
endmenu


menu "Networking"
	config LWIP
		bool "Enable LWIP"
		default n

	config LWIP_DEBUG
		depends on LWIP
		bool "LWIP Debug prints"
		default n
endmenu



config ENABLE_USERSPACE
	bool "Enable Userspace"
	default y

menu "Userspace"

	depends on ENABLE_USERSPACE
	
	config FANCY_WINDOWS
		bool "Fancy Rounded windows"
		default y


	config GFX_FONT_MONO
		bool "Monochrome font (no blending)"
		default n


	config SIMPLE_INIT
		bool "Simple init (Only launch a shell, no services)"
		default n

endmenu
```

## arch/Kconfig
```kconfig
config ARCH_NAME
	string
	default "x86_64" if X86 && 64BIT
	default "i386" if X86 && !64BIT
	default "riscv64" if RISCV && 64BIT
	default "riscv32" if RISCV && !64BIT
	default "aarch64" if ARM64

config ARCH_DIR
	string
	default "x86" if X86
	default "riscv" if RISCV
	default "arm64" if ARM64

# The root architecture configuration
choice
	prompt "Architecture"
	default X86

	config X86
		bool "x86_64"
		

	config RISCV
		bool "RISC-V"

	config ARM64
		bool "ARM64"

endchoice


config KERNEL_VIRTUAL_BASE
	hex
	default ffff880000000000 if X86
	# riscv
	default 0x80000000 if SV32 && RISCV
	default 0xffffffc000000000 if SV39 && RISCV
	default 0xffff800000000000 if SV48 && RISCV

	# arm64
	default 0xffffffff80000000 if ARM64


menu "x86_64 Configuration"
	depends on X86
	source "arch/x86/Kconfig"
endmenu


menu "RISC-V Configuration"
	depends on RISCV
	source "arch/riscv/Kconfig"
endmenu



config 64BIT
	# bool "64bit"
	bool
	default y


menu "ARM64 Configuration"
	depends on ARM64
	source "arch/arm64/Kconfig"
endmenu
```

## arch/arm64/Kconfig
```kconfig
config BCM28XX
	bool

depends on ARM64


# select a platform for ARM64
choice
	prompt "Platform"
	default QEMU_VIRT_ARM64

	config QEMU_VIRT_ARM64
		bool "Virtual ARM64 Processor used by QEMU"

	config BCM2837
		bool "Broadcom 2837 Processors (Raspberry Pi 3)"
		select BCM28XX

	config BCM2711
		bool "Broadcom 2711 (Raspberry Pi 4)"

endchoice
```

## arch/riscv/Kconfig
```kconfig
# config RISCV_MARCH
# 	string "RISC-V Instruction Set"
# 	default "rv64g"
# 
# 
# config RISCV_MABI
# 	string "RISC-V ABI"
# 	default "lp64"


config RISCV_RAM_MB
	int "RAM size"
	default 128
	help
		risc-v doesn't seem to have an obvious way to query
		ram count, so we have to hard code it I think (idk)

config RISCV_BOOTSTACK_SIZE
	int "Per-HART boot stack size (in pages)"
	default 2

choice
	prompt "Virtual memory system"
	default SV48


	config SV32
		bool "Sv32 - 32-bit paging"
		depends on !64BIT

	config SV39
		bool "Sv39 - 39-bit paging"
		depends on 64BIT

	config SV48
		bool "Sv48 - 48-bit paging"
		depends on 64BIT
endchoice



config RISCV_QEMU_VIRT
	bool "[platform] QEMU virt machine"
	default y


config RISCV_CLOCKS_PER_SECOND
	int "Clocks per second (mtime clock rate, 10MHz in QEMU virt)"
	default 10000000


# choice
# 	prompt "Architecture size"
# 	default RISCV64
# 
# 	config RISCV64
# 		bool "RISC-V 64bit"
# 
# 
# 	config RISCV32
# 		bool "RISC-V 32bit"
# 
# endchoice
```

## arch/x86/Kconfig
```kconfig
# TODO
config ACPI
	bool "Enable ACPI"
	default y


config X2APIC
	bool "Use X2APIC if able"
	default y
```
